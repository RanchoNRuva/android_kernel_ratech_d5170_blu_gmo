## drivers/misc/mediatek/fingerprint/Kconfig
```kconfig
config CUSTOM_KERNEL_FINGERPRINT
	bool "CUSTOM_KERNEL_FINGERPRINT"
	help
	  FINGERPRINT sensor driver to detect ambient light and the object is close
	  or far awary from device. After configure this configuration,
          the specific ambient light and proximity sensor driver configuration
          should be configured as well.


source "drivers/misc/mediatek/fingerprint/gx368/Kconfig"
```

## drivers/misc/mediatek/fingerprint/gx368/Kconfig
```kconfig
config MTK_GX368
	bool "MTK_GX368 for MediaTek package"
	default n
	help
	It support different type sensor
	in this platform. If this option
	is set, it will support ambient
	and fingerprint sensor MTK_GX368.
```

## drivers/misc/mediatek/freqhopping/Kconfig
```kconfig
config MTK_FREQ_HOPPING
    tristate "MediaTek FREQHOPPING driver"
    default N
    help
      FREQHOPPING driver support for MediaTek SOC
      If you want to use MediaTek FREQHOPPING driver, say Y or M here.If unsure, say N.

config RGK_MEM_PLL_DISABLE_SSC
	bool "RGK_MEM_PLL_DISABLE_SSC"
	default n
	help
      control the memory pll ssc support
      if you want to disable memory pll ssc ,say Y here，otherwise ,say N.
```
